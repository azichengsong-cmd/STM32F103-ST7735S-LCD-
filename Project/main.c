/*
==================================================
    主程序文件 (main.c)

    功能：
    STM32嵌入式系统主程序，集成BMP180传感器、LCD显示、
    OneNET MQTT云平台上传、Modbus RS485通信、报警、
    Flash历史数据存储、天气获取等功能。

    系统架构：
    - TIM2定时器：10ms中断，产生500ms传感器更新和30s MQTT上传标志
    - 主循环：轮询处理Modbus、传感器更新、UI显示、按键、MQTT上传、Flash保存

    定时器时序说明：
    - TIM2中断周期：10ms (72MHz/7200/100 = 100Hz)
    - 传感器数据更新：每500ms (Sensor_Count计数到50，50×10ms=500ms)
    - MQTT数据上传：每30s (MQTT_Count计数到3000，3000×10ms=30000ms=30s)
    - Flash历史数据保存：每30s (与MQTT上传同步执行)

    中断优先级分配(NVIC_PriorityGroup_2)：
    - USART2(抢占0)：Air780E通信，最高优先级
    - TIM2(抢占2)：系统节拍
    - USART1(抢占3)：调试串口，最低优先级
==================================================
*/
#include "stm32f10x.h"

#include "delay.h"
#include "usart.h"

#include "lcd.h"
#include "lcd_init.h"

#include "key.h"
#include "ui.h"

#include "iic.h"
#include "bmp180.h"
#include "sensor.h"

#include "led.h"
#include "beep.h"
#include "alarm.h"

#include "onenet.h"
#include "weather.h"

#include "rs485.h"
#include "modbus.h"

#include "flash.h"


/*
==================================================
                    全局变量
==================================================
*/


/*
--------------------------------------------------
TIM2 10ms系统节拍

每10ms进入一次TIM2中断。

volatile关键字说明：
这些变量在中断函数中修改，在主循环中读取。
volatile确保编译器不会优化掉对这些变量的访问，
每次都从内存重新读取最新值。
--------------------------------------------------
*/

volatile u8 Sensor_Update_Flag = 0;  /* 传感器更新标志：1=需要更新(500ms到)，由TIM2中断设置，主循环清除 */


/*
--------------------------------------------------
MQTT上传标志

TIM2负责计时。
主循环负责真正执行MQTT上传。
--------------------------------------------------
*/

volatile u8 MQTT_Upload_Flag = 0;  /* MQTT上传标志：1=需要上传(30s到)，由TIM2中断设置，主循环清除 */


/*
--------------------------------------------------
MQTT计数器

TIM2：

10ms × 3000
= 30000ms
= 30s
--------------------------------------------------
*/

volatile u16 MQTT_Count = 0;  /* MQTT上传计数器：0~3000，每10ms+1，到3000(30s)触发上传，主循环首次上传后重置为0 */


/*
==================================================
                    TIM2初始化
                    10ms一次中断
==================================================

    函数名：TIM2_Init
    功能：初始化TIM2定时器，配置为每10ms产生一次更新中断
    参数：无
    返回值：无

    时钟计算：
    - APB1总线时钟 = 36MHz
    - APB1预分频不为1，定时器时钟 = APB1 × 2 = 72MHz
    - 预分频值 = 7200-1，计数频率 = 72MHz/7200 = 10kHz
    - 自动重装载值 = 100-1，中断周期 = 100/10kHz = 10ms

    中断优先级：
    - 抢占优先级2，子优先级0
*/

void TIM2_Init(void)
{
    TIM_TimeBaseInitTypeDef TIM_TimeBaseStructure;
    NVIC_InitTypeDef NVIC_InitStructure;


    /*
    ==============================================
                    TIM2时钟
    ==============================================

    STM32F103：

    APB1 = 36MHz

    APB1预分频不为1时，
    定时器时钟 = APB1 × 2

    TIM2 = 72MHz
    ==============================================
    */

    RCC_APB1PeriphClockCmd(
        RCC_APB1Periph_TIM2,
        ENABLE
    );


    /*
    ==============================================
                    定时器参数
    ==============================================

    72MHz / 7200
    = 10kHz

    10kHz / 100
    = 100Hz

    100Hz
    = 10ms一次
    ==============================================
    */

    TIM_TimeBaseStructure.TIM_Prescaler =
        7200 - 1;

    TIM_TimeBaseStructure.TIM_CounterMode =
        TIM_CounterMode_Up;

    TIM_TimeBaseStructure.TIM_Period =
        100 - 1;

    TIM_TimeBaseStructure.TIM_ClockDivision =
        TIM_CKD_DIV1;


    TIM_TimeBaseInit(
        TIM2,
        &TIM_TimeBaseStructure
    );


    /*
    ==============================================
                    开启更新中断
    ==============================================
    */

    TIM_ITConfig(
        TIM2,
        TIM_IT_Update,
        ENABLE
    );


    /*
    ==============================================
                    NVIC配置
    ==============================================
    */

    NVIC_InitStructure.NVIC_IRQChannel =
        TIM2_IRQn;

    NVIC_InitStructure.NVIC_IRQChannelPreemptionPriority =
        2;

    NVIC_InitStructure.NVIC_IRQChannelSubPriority =
        0;

    NVIC_InitStructure.NVIC_IRQChannelCmd =
        ENABLE;


    NVIC_Init(
        &NVIC_InitStructure
    );


    /*
    ==============================================
                    启动TIM2
    ==============================================
    */

    TIM_Cmd(
        TIM2,
        ENABLE
    );
}


/*
==================================================
                    TIM2中断
==================================================

    函数名：TIM2_IRQHandler
    功能：TIM2更新中断处理函数，每10ms执行一次
    参数：无
    返回值：无

    任务：
    1. 每500ms产生一次Sensor_Update_Flag(传感器更新标志)
       - Sensor_Count从0计数到50，50×10ms=500ms
    2. 每30s产生一次MQTT_Upload_Flag(MQTT上传标志)
       - MQTT_Count从0计数到3000，3000×10ms=30000ms=30s

    注意：
    这里只负责计时和设置标志。

    不能在这里：

    - Sensor_Update()
    - LCD操作
    - Modbus发送
    - MQTT发送
    - delay_ms()

    原因：中断函数中执行耗时操作会导致中断响应延迟，
    影响其他中断(如USART2)的正常工作。
==================================================
*/

void TIM2_IRQHandler(void)
{
    static u8 Sensor_Count = 0;  /* 传感器更新计数器，每10ms+1，到50(500ms)触发 */


    /*
    ==============================================
                    判断更新中断
    ==============================================
    */

    if(
        TIM_GetITStatus(
            TIM2,
            TIM_IT_Update
        ) != RESET
    )
    {
        /*
        ------------------------------------------
                清除中断标志
        ------------------------------------------
        清除标志位是必须的，否则会持续触发中断
        */

        TIM_ClearITPendingBit(
            TIM2,
            TIM_IT_Update
        );


        /*
        ==========================================
                    500ms传感器任务
        ==========================================

        50 × 10ms
        = 500ms

        每10ms中断中Sensor_Count加1，
        当计数到50时(即500ms)：
        1. 重置计数器为0
        2. 设置Sensor_Update_Flag=1通知主循环执行传感器更新
        */

        Sensor_Count++;


        if(Sensor_Count >= 50)
        {
            Sensor_Count = 0;  /* 重置传感器更新计数器 */

            Sensor_Update_Flag = 1;  /* 设置传感器更新标志，主循环检测后执行 */
        }


        /*
        ==========================================
                    30秒MQTT任务
        ==========================================

        3000 × 10ms
        = 30000ms
        = 30s

        每10ms中断中MQTT_Count加1，
        当计数到3000时(即30s)：
        1. 重置计数器为0
        2. 设置MQTT_Upload_Flag=1通知主循环执行MQTT数据上传
        3. 主循环中MQTT上传完成后同时执行Flash历史数据保存
        */

        MQTT_Count++;


        if(MQTT_Count >= 3000)
        {
            MQTT_Count = 0;  /* 重置MQTT上传计数器 */

            MQTT_Upload_Flag = 1;  /* 设置MQTT上传标志，主循环检测后执行 */
        }
    }
}


/*
==================================================
                    MAIN
==================================================

    函数名：main
    功能：系统主函数，完成所有外设初始化后进入主循环
    参数：无
    返回值：int (实际上不会返回，主循环为死循环)

    初始化序列(共20步)：
    1.  NVIC中断优先级分组
    2.  系统延时初始化
    3.  USART1(调试串口)
    4.  USART2(Air780E)
    5.  IIC(必须在BMP180之前)
    6.  LCD显示
    7.  KEY按键
    8.  LED
    9.  BEEP蜂鸣器
    10. BMP180气压传感器(依赖IIC)
    11. Sensor传感器模块(依赖BMP180)
    11.5 Flash存储(必须在UI之前)
    12. RS485
    13. Modbus(依赖RS485)
    14. Alarm报警
    15. UI界面
    16. TIM2定时器(最后启动)
    17. 首次读取传感器
    18. 更新Modbus寄存器
    19. 获取天气
    20. 连接MQTT并首次上传

    主循环任务：
    1. Modbus持续处理
    2. 500ms传感器更新(检测Sensor_Update_Flag)
    3. UI页面处理
    4. 按键处理
    5. 30s MQTT上传+Flash保存(检测MQTT_Upload_Flag)
==================================================
*/

int main(void)
{
    /*
    ==================================================
                    第一步：NVIC
    ==================================================
    设置中断优先级分组为Group2：
    2位抢占优先级(0~3) + 2位子优先级(0~3)
    必须在所有外设初始化之前设置
    ==================================================
    */

    NVIC_PriorityGroupConfig(
        NVIC_PriorityGroup_2
    );


    /*
    ==================================================
                    第二步：系统延时
    ==================================================
    */

    delay_init();


    /*
    ==================================================
                    第三步：USART1
                    调试串口
    ==================================================
    */

    usart_init();


    /*
    ==================================================
                    第四步：USART2
                    Air780E
    ==================================================
    */

    usart2_init();


    /*
    ==================================================
                    第五步：IIC
    ==================================================

    注意：

    IIC必须在BMP180之前初始化。

    BMP180通过IIC通信。
    ==================================================
    */

    IIC_init();


    /*
    ==================================================
                    第六步：LCD
    ==================================================
    */

    LCD_Init();


    /*
    ==================================================
                    第七步：KEY
    ==================================================
    */

    key_init();


    /*
    ==================================================
                    第八步：LED
    ==================================================
    */

    led_init();


    /*
    ==================================================
                    第九步：BEEP
    ==================================================
    */

    beep_init();


    /*
    ==================================================
                    第十步：BMP180
    ==================================================

    此时IIC已经初始化完成。
    ==================================================
    */

    BMP180_Init();


    /*
    ==================================================
                    第十一步：Sensor
    ==================================================

    Sensor模块依赖BMP180。
    ==================================================
    */

    Sensor_Init();


    /*
    ==================================================
                    第十一步半：Flash
    ==================================================

    恢复历史数据
    必须在 UI 之前初始化

    UI_History 界面会读取 flash_data
    ==================================================
    */

    Flash_Init();


    /*
    ==================================================
                    第十二步：RS485
    ==================================================
    */

    RS485_Init();


    /*
    ==================================================
                    第十三步：Modbus
    ==================================================

    Modbus依赖RS485。
    ==================================================
    */

    Modbus_Init();


    /*
    ==================================================
                    第十四步：Alarm
    ==================================================
    */

    Alarm_Init();


    /*
    ==================================================
                    第十五步：UI
    ==================================================
    */

    UI_Init();


    /*
    ==================================================
                    第十六步：TIM2
    ==================================================

    所有基础外设初始化完成以后，
    最后启动TIM2。

    TIM2启动以后才开始产生10ms中断。
    延迟启动的原因：
    确保所有外设(传感器、UI、Modbus等)都已就绪，
    避免TIM2中断标志触发时相关模块尚未初始化完成。
    ==================================================
    */

    TIM2_Init();


    /*
    ==================================================
                    第十七步：第一次读取传感器
    ==================================================

    不等待500ms。
    上电立即读取BMP180。

    原因：上电后需要尽快获取传感器数据，
    用于LCD初始显示和Modbus寄存器初始化，
    不必等待TIM2的500ms标志。
    ==================================================
    */

    Sensor_Update();


    /*
    ==================================================
                    第十八步：更新Modbus寄存器
    ==================================================

    将第一次读取的：

    温度
    气压
    海拔

    写入Modbus寄存器。
    ==================================================
    */

    Modbus_UpdateRegisters();


    /*
    ==================================================
                    第十九步：获取天气
    ==================================================

    上电获取一次天气。
    ==================================================
    */

    printf(
        "\r\n========== WEATHER GET ==========\r\n"
    );


    if(Weather_Get() == 0)
    {
        printf(
            "WEATHER GET SUCCESS\r\n"
        );


        printf(
            "CITY:%s\r\n",
            weather.city
        );


        printf(
            "TEXT:%s\r\n",
            weather.text
        );


        printf(
            "TEMP:%s\r\n",
            weather.temperature
        );
    }
    else
    {
        printf(
            "WEATHER GET FAIL\r\n"
        );
    }


    /*
    ==================================================
                    第二十步：连接MQTT
    ==================================================
    延时500ms等待Air780E模块就绪，
    然后执行MQTT连接流程。
    ==================================================
    */

    delay_ms(500);  /* 等待Air780E模块稳定就绪 */


    printf(
        "\r\n========== MQTT CONNECT ==========\r\n"
    );


    if(Connect_init() == 0)
    {
        /*
        ------------------------------------------
                MQTT连接成功
        ------------------------------------------
        */

        printf(
            "MQTT CONNECT SUCCESS\r\n"
        );


        /*
        ==========================================
                第一次立即上传
        ==========================================

        不等待30秒。
        连接成功以后立即上传。
        */

        printf(
            "MQTT FIRST UPLOAD START\r\n"
        );


        /*
        ------------------------------------------
                    上传温度
        ------------------------------------------
        */

        if(
            Up_Temp_Data(
                sensor.temp
            )
        )
        {
            printf(
                "TEMP UPLOAD OK\r\n"
            );
        }
        else
        {
            printf(
                "TEMP UPLOAD FAIL\r\n"
            );
        }


        /*
        ------------------------------------------
                    上传气压
        ------------------------------------------
        */

        if(
            Up_Pressure_Data(
                sensor.pressure
            )
        )
        {
            printf(
                "PRESSURE UPLOAD OK\r\n"
            );
        }
        else
        {
            printf(
                "PRESSURE UPLOAD FAIL\r\n"
            );
        }


        /*
        ------------------------------------------
                    上传海拔
        ------------------------------------------
        */

        if(
            Up_Altitude_Data(
                sensor.altitude
            )
        )
        {
            printf(
                "ALTITUDE UPLOAD OK\r\n"
            );
        }
        else
        {
            printf(
                "ALTITUDE UPLOAD FAIL\r\n"
            );
        }


        printf(
            "MQTT FIRST UPLOAD END\r\n"
        );


        /*
        ==========================================
            非常重要：

            第一次上传完成以后，
            MQTT 30秒计时重新开始。

            防止TIM2在HTTP/MQTT初始化期间
            已经累计了一部分时间。

            原因：
            从TIM2启动到首次MQTT上传完成，
            中间经历了天气获取、MQTT连接等耗时操作，
            TIM2中断可能已经将MQTT_Count累计到较大值。
            如果不重置，会导致下一次MQTT上传
            不到30s就提前触发。
        ==========================================
        */

        MQTT_Count = 0;  /* 重置MQTT计数器，30s计时从现在开始 */

        MQTT_Upload_Flag = 0;  /* 清除可能在中途被TIM2设置的标志 */
    }
    else
    {
        /*
        ------------------------------------------
                MQTT连接失败
        ------------------------------------------
        */

        printf(
            "MQTT CONNECT FAIL\r\n"
        );


        /*
        ------------------------------------------
        即使MQTT连接失败，
        30秒计时也重新开始。

        原因：
        无论连接成功与否，都需要从当前时刻开始
        重新计时30s，确保下次MQTT上传/重连
        在30s后准时触发。
        ------------------------------------------
        */

        MQTT_Count = 0;  /* 重置MQTT计数器 */

        MQTT_Upload_Flag = 0;  /* 清除标志 */
    }


    /*
    ==================================================
                    系统启动完成
    ==================================================
    所有初始化步骤已完成，输出系统启动标志。
    此后程序进入主循环，开始正常工作。
    ==================================================
    */

    printf(
        "\r\nSYSTEM START\r\n"
    );


    /*
    ==================================================
                    主循环
    ==================================================

    主循环采用轮询+标志位的混合设计模式：
    - Modbus处理：每轮循环都执行(最高频率)
    - 传感器更新：由TIM2的500ms标志触发
    - UI显示：每轮循环都执行(保证响应性)
    - 按键处理：每轮循环都执行(保证响应性)
    - MQTT上传+Flash保存：由TIM2的30s标志触发

    这种设计确保：
    1. Modbus通信不丢数据(每轮都处理)
    2. 传感器数据500ms刷新(足够实时)
    3. UI和按键响应迅速(每轮执行)
    4. MQTT上传不过于频繁(30s周期)
    */

    while(1)
    {
        /*
        ==================================================
                    1. Modbus持续处理
        ==================================================

        RS485收到数据以后，
        Modbus_Process()负责处理。

        这个任务必须持续运行。
        原因：Modbus是请求-响应协议，
        主机可能随时发送请求，必须及时响应，
        否则会导致通信超时。
        ==================================================
        */

        Modbus_Process();


        /*
        ==================================================
                    2. 500ms传感器更新
        ==================================================

        标志位驱动模式：
        TIM2中断每500ms设置Sensor_Update_Flag=1，
        主循环检测到标志后执行传感器更新。
        这种"中断设置标志+主循环执行"的模式
        避免了在中断中执行耗时操作。
        */

        if(Sensor_Update_Flag)
        {
            /*
            ------------------------------------------
                    清除标志
            ------------------------------------------
            先清除标志再执行任务，防止任务执行期间
            TIM2再次设置标志被遗漏
            */

            Sensor_Update_Flag = 0;


            /*
            ------------------------------------------
                    更新BMP180
            ------------------------------------------
            */

            Sensor_Update();


            /*
            ------------------------------------------
                    更新Modbus寄存器
            ------------------------------------------
            */

            Modbus_UpdateRegisters();


            /*
            ------------------------------------------
                    报警检测
            ------------------------------------------
            */

            Alarm_Check(
                sensor.temp,
                sensor.pressure
            );


            /*
            ------------------------------------------
                    LCD传感器数据显示
            ------------------------------------------
            */

            UI_ShowSensor();
        }


        /*
        ==================================================
                    3. UI页面处理
        ==================================================

        UI_Show负责：

        - 页面第一次显示
        - 页面切换
        - 设置页面
        - UI刷新
        ==================================================
        */

        UI_Show();


        /*
        ==================================================
                    4. 按键处理
        ==================================================
        */

        UI_Key_Handler();


        /*
        ==================================================
                    5. MQTT 30秒上传
        ==================================================

        标志位驱动模式：
        TIM2中断每30s设置MQTT_Upload_Flag=1，
        主循环检测到标志后执行MQTT数据上传。
        上传完成后同时执行Flash历史数据保存。
        */

        if(MQTT_Upload_Flag)
        {
            /*
            ------------------------------------------
                    清除上传标志
            ------------------------------------------
            先清除标志再执行上传，防止上传期间
            TIM2再次设置标志被遗漏
            */

            MQTT_Upload_Flag = 0;


            /*
            ------------------------------------------
                    打印日志
            ------------------------------------------
            */

            printf(
                "\r\n========== MQTT 30S UPLOAD ==========\r\n"
            );


            /*
            ------------------------------------------
                    上传温度
            ------------------------------------------
            */

            if(
                Up_Temp_Data(
                    sensor.temp
                )
            )
            {
                printf(
                    "TEMP UPLOAD OK\r\n"
                );
            }
            else
            {
                printf(
                    "TEMP UPLOAD FAIL\r\n"
                );
            }


            /*
            ------------------------------------------
                    上传气压
            ------------------------------------------
            */

            if(
                Up_Pressure_Data(
                    sensor.pressure
                )
            )
            {
                printf(
                    "PRESSURE UPLOAD OK\r\n"
                );
            }
            else
            {
                printf(
                    "PRESSURE UPLOAD FAIL\r\n"
                );
            }


            /*
            ------------------------------------------
                    上传海拔
            ------------------------------------------
            */

            if(
                Up_Altitude_Data(
                    sensor.altitude
                )
            )
            {
                printf(
                    "ALTITUDE UPLOAD OK\r\n"
                );
            }
            else
            {
                printf(
                    "ALTITUDE UPLOAD FAIL\r\n"
                );
            }


            /*
            ------------------------------------------
                    上传结束
            ------------------------------------------
            */

            printf(
                "MQTT 30S UPLOAD END\r\n"
            );


            /*
            ------------------------------------------
                    Flash 历史数据保存

            每 30 秒随 MQTT 上传一起保存
            累加当前传感器数据到历史平均值
            写入 Flash 断电不丢失

            说明：
            Flash保存与MQTT上传放在同一30s周期中执行，
            避免频繁写Flash影响Flash寿命(Flash擦写次数有限)。
            保存的数据包括：温度、气压、海拔的历史累计值和平均值。
            ------------------------------------------
            */

            Flash_Save(
                sensor.temp,
                sensor.pressure,
                sensor.altitude
            );
        }
    }
}

