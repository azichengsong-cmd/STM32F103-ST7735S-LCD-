#include "iic.h"
#include "delay.h"
#include "usart.h"



/*================================================
 * IIC初始化
 *
 * 功能说明：
 *     初始化GPIO模拟IIC的引脚（PC6=SCL, PC7=SDA），
 *     配置为开漏输出模式，并将总线拉高（空闲状态）。
 *
 * 参数说明：无
 * 返回值：  无
 *================================================*/
void IIC_init(){
	/* 配置SCL PC6 SDA PC7 */
	GPIO_InitTypeDef GPIO_InitStruct;/* 通过结构体类型定义结构体变量 */

	RCC_APB2PeriphClockCmd(RCC_APB2Periph_GPIOC,ENABLE);/* 使能GPIOC的端口时钟 */


	GPIO_InitStruct.GPIO_Pin = GPIO_Pin_6|GPIO_Pin_7;/* PIN引脚：PC6(SCL) + PC7(SDA) */
	GPIO_InitStruct.GPIO_Mode = GPIO_Mode_Out_OD;/* 开漏输出模式，适配IIC总线 */
	GPIO_InitStruct.GPIO_Speed = GPIO_Speed_50MHz;/* 工作速度：50MHz */
	GPIO_Init(GPIOC,&GPIO_InitStruct);/* 根据设定的参数初始化GPIOC */

	IIC_SDA=1;  /* SDA拉高，总线空闲 */
	IIC_SCL=1;  /* SCL拉高，总线空闲 */


}

/*================================================
 * IIC起始信号
 *
 * 功能说明：
 *     产生IIC起始条件：SCL为高时，SDA由高变低。
 *     起始信号后SCL拉低，准备开始数据传输。
 *
 * 参数说明：无
 * 返回值：  无
 *================================================*/
void IIC_Start(){
	SDA_OUT();      /* SDA切换为输出模式 */
	IIC_SDA=1;      /* SDA拉高 */
	IIC_SCL=1;      /* SCL拉高 */
	delay_us(4);    /* 保持4us */
	IIC_SDA=0;      /* SCL为高时SDA下降沿，产生起始信号 */
	delay_us(4);    /* 保持4us */
	IIC_SCL=0;      /* SCL拉低，准备传输数据 */

}

/*================================================
 * IIC停止信号
 *
 * 功能说明：
 *     产生IIC停止条件：SCL为高时，SDA由低变高。
 *     停止信号后总线恢复空闲状态。
 *
 * 参数说明：无
 * 返回值：  无
 *================================================*/
void IIC_Stop(){
	SDA_OUT();      /* SDA切换为输出模式 */
	IIC_SCL=0;      /* SCL拉低 */
	IIC_SDA=0;      /* SDA拉低 */
	delay_us(4);    /* 保持4us */
	IIC_SCL=1;      /* SCL拉高 */
	delay_us(4);    /* 保持4us */
	IIC_SDA=1;      /* SCL为高时SDA上升沿，产生停止信号 */
}

/*================================================
 * IIC发送应答信号（ACK）
 *
 * 功能说明：
 *     在SCL低电平时将SDA拉低，然后产生一个SCL脉冲，
 *     表示主机已接收到数据，可以继续发送下一字节。
 *
 * 参数说明：无
 * 返回值：  无
 *================================================*/
void IIC_Ack(){
	SDA_OUT();      /* SDA切换为输出模式 */
	IIC_SCL=0;      /* SCL拉低 */
	IIC_SDA=0;      /* SDA拉低，表示ACK */
	delay_us(4);    /* 保持4us */
	IIC_SCL=1;      /* SCL拉高，产生时钟脉冲 */
	delay_us(4);    /* 保持4us */
	IIC_SCL=0;      /* SCL拉低，完成应答 */
}


/*================================================
 * IIC发送非应答信号（NACK）
 *
 * 功能说明：
 *     在SCL低电平时将SDA拉高，然后产生一个SCL脉冲，
 *     表示主机不再接收数据，通知从机停止发送。
 *
 * 参数说明：无
 * 返回值：  无
 *================================================*/
void IIC_NAck(){
	SDA_OUT();      /* SDA切换为输出模式 */
	IIC_SCL=0;      /* SCL拉低 */
	IIC_SDA=1;      /* SDA拉高，表示NACK */
	delay_us(4);    /* 保持4us */
	IIC_SCL=1;      /* SCL拉高，产生时钟脉冲 */
	delay_us(4);    /* 保持4us */
	IIC_SCL=0;      /* SCL拉低，完成非应答 */
}

/*================================================
 * IIC等待应答信号
 *
 * 功能说明：
 *     主机发送一个字节后，释放SDA总线并产生SCL脉冲，
 *     等待从机拉低SDA作为应答。超时（200次轮询）
 *     则认为通信失败，发送停止信号。
 *
 * 参数说明：无
 *
 * 返回值：
 *     0 - 收到应答（ACK）
 *     1 - 未收到应答（NACK/超时）
 *================================================*/
u8 IIC_Wait_Ack(){
	u8 time=0;
	SDA_IN();           /* SDA切换为输入模式，准备读取从机应答 */
	IIC_SCL=1;          /* SCL拉高，产生时钟脉冲让从机输出应答 */
	while(READ_SDA){    /* 等待SDA被从机拉低 */
		time++;
		if(time > 200){  /* 超过200次轮询，认为超时 */
				IIC_Stop(); /* 发送停止信号，释放总线 */
				return 1;   /* 返回非应答 */
		}
	}
	IIC_SCL=0;          /* SCL拉低，完成应答时序 */
	return 0;           /* 返回应答成功 */
}

/*================================================
 * IIC发送一个字节
 *
 * 功能说明：
 *     通过IIC总线发送一个字节（8位），MSB先发。
 *     每个位在SCL低电平时设置SDA，SCL上升沿锁存。
 *
 * 参数说明：
 *     tx - 要发送的字节数据
 *
 * 返回值：  无
 *================================================*/
void IIC_Send_Byte(u8 tx){
	SDA_OUT();           /* SDA切换为输出模式 */
	IIC_SCL=0;           /* SCL拉低，准备发送 */
	for(u8 i=0;i<8;i++){ /* 循环发送8位，MSB在前 */
		IIC_SDA=tx>>7;   /* 取最高位输出到SDA */
		tx = tx<<1;      /* 左移一位，准备下一位 */
		delay_us(2);      /* 保持数据稳定 */
		IIC_SCL=1;       /* SCL拉高，上升沿锁存数据 */
		delay_us(4);      /* 保持时钟高电平 */
		IIC_SCL=0;       /* SCL拉低，准备下一位 */
		delay_us(2);      /* 保持时钟低电平 */
	}
}


/*================================================
 * IIC读取一个字节
 *
 * 功能说明：
 *     通过IIC总线读取一个字节（8位），MSB先收。
 *     每个位在SCL低电平后拉高，在SCL高电平时读取SDA。
 *     读取完成后根据参数发送ACK或NACK。
 *
 * 参数说明：
 *     ack - 0：发送NACK（读取最后一个字节时使用）
 *           1：发送ACK （还需继续读取时使用）
 *
 * 返回值：
 *     读取到的字节数据
 *================================================*/
u8 IIC_Read_Byte(u8 ack){
	u8 receive = 0;
	SDA_IN();           /* SDA切换为输入模式，准备读取从机数据 */
	for(u8 i=0;i<8;i++){ /* 循环读取8位，MSB在前 */
		IIC_SCL=0;       /* SCL拉低，让从机准备下一位数据 */
		delay_us(4);      /* 保持4us */
		IIC_SCL=1;       /* SCL拉高，读取SDA数据 */
		delay_us(2);      /* 保持2us */
		receive <<= 1;   /* 接收缓冲左移一位，腾出最低位 */
		receive |= READ_SDA; /* 读取SDA到最低位 */
		delay_us(2);      /* 保持2us */
	}
	if(ack){            /* 需要继续读取，发送ACK */
		IIC_Ack();
	}else{              /* 读取结束，发送NACK */
		IIC_NAck();
	}

	return receive;     /* 返回读取到的字节 */
}




/*================================================
 * IIC总线设备扫描
 *
 * 功能说明：
 *     遍历IIC总线上所有可能的7位地址（1~126），
 *     对每个地址发送起始信号和设备地址+写方向，
 *     如果收到ACK则说明该地址有设备存在，打印地址。
 *     用于调试时发现总线上的IIC设备。
 *
 * 参数说明：无
 * 返回值：  无
 *================================================*/
void IIC_Scan(void)
{

u8 addr;


for(addr=1;addr<127;addr++) /* 遍历所有可能的IIC设备地址 */
{

IIC_Start();               /* 发起IIC起始信号 */


IIC_Send_Byte(addr<<1);    /* 发送设备地址 + 写方向（左移1位后最低位为0） */


if(IIC_Wait_Ack()==0)      /* 收到应答，说明该地址有设备 */
{
printf("Device:0x%02X\r\n",addr); /* 打印发现的设备地址 */
}


IIC_Stop();                /* 发送停止信号，结束本次探测 */

}


}
